## boards/shields/pkkblab/Kconfig.defconfig
```kconfig
if SHIELD_PKKBLAB_LEFT

config ZMK_KEYBOARD_NAME
    default "pkkblab"

config ZMK_SPLIT_ROLE_CENTRAL
    default y

endif

if SHIELD_PKKBLAB_LEFT || SHIELD_PKKBLAB_RIGHT

config ZMK_SPLIT
    default y

endif
```

## boards/shields/pkkblab/Kconfig.shield
```kconfig
config SHIELD_PKKBLAB_LEFT
    def_bool $(shields_list_contains,pkkblab_left)

config SHIELD_PKKBLAB_RIGHT
    def_bool $(shields_list_contains,pkkblab_right)
```

## config/west.yml
```yaml
manifest:
  remotes:
    - name: zmkfirmware
      url-base: https://github.com/zmkfirmware
  projects:
    - name: zmk
      remote: zmkfirmware
      revision: v0.30
      import: app/west.yml
  self:
    path: config
```
